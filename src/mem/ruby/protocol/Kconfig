## src/mem/ruby/protocol/Kconfig
```kconfig
# Copyright 2022 Google, Inc.
#
# Redistribution and use in source and binary forms, with or without
# modification, are permitted provided that the following conditions are
# met: redistributions of source code must retain the above copyright
# notice, this list of conditions and the following disclaimer;
# redistributions in binary form must reproduce the above copyright
# notice, this list of conditions and the following disclaimer in the
# documentation and/or other materials provided with the distribution;
# neither the name of the copyright holders nor the names of its
# contributors may be used to endorse or promote products derived from
# this software without specific prior written permission.
#
# THIS SOFTWARE IS PROVIDED BY THE COPYRIGHT HOLDERS AND CONTRIBUTORS
# "AS IS" AND ANY EXPRESS OR IMPLIED WARRANTIES, INCLUDING, BUT NOT
# LIMITED TO, THE IMPLIED WARRANTIES OF MERCHANTABILITY AND FITNESS FOR
# A PARTICULAR PURPOSE ARE DISCLAIMED. IN NO EVENT SHALL THE COPYRIGHT
# OWNER OR CONTRIBUTORS BE LIABLE FOR ANY DIRECT, INDIRECT, INCIDENTAL,
# SPECIAL, EXEMPLARY, OR CONSEQUENTIAL DAMAGES (INCLUDING, BUT NOT
# LIMITED TO, PROCUREMENT OF SUBSTITUTE GOODS OR SERVICES; LOSS OF USE,
# DATA, OR PROFITS; OR BUSINESS INTERRUPTION) HOWEVER CAUSED AND ON ANY
# THEORY OF LIABILITY, WHETHER IN CONTRACT, STRICT LIABILITY, OR TORT
# (INCLUDING NEGLIGENCE OR OTHERWISE) ARISING IN ANY WAY OUT OF THE USE
# OF THIS SOFTWARE, EVEN IF ADVISED OF THE POSSIBILITY OF SUCH DAMAGE.

config PROTOCOL
    default "GPU_VIPER" if RubyProtocolGpuViper
    default "MOESI_AMD_Base" if RubyProtocolMoesiAmdBase
    default "MESI_Two_Level" if RubyProtocolMesiTwoLevel
    default "MESI_Three_Level" if RubyProtocolMesiThreeLevel
    default "MESI_Three_Level_HTM" if RubyProtocolMesiThreeLevelHtm
    default "MI_example" if RubyProtocolMiExample
    default "MOESI_CMP_directory" if RubyProtocolMoesiCmpDirectory
    default "MOESI_CMP_token" if RubyProtocolMoesiCmpToken
    default "MOESI_hammer" if RubyProtocolMoesiHammer
    default "Garnet_standalone" if RubyProtocolGarnetStandalone

cont_choice "Ruby protocol"
    config RubyProtocolGpuViper
        bool "GPU VIPER"
        depends on BUILD_GPU
    config RubyProtocolMoesiAmdBase
        bool "MOESI AMD base"
    config RubyProtocolMesiTwoLevel
        bool "MESI two level"
    config RubyProtocolMesiThreeLevel
        bool "MESI three level"
    config RubyProtocolMesiThreeLevelHtm
        bool "MESI three level HTM"
    config RubyProtocolMiExample
        bool "MI example"
    config RubyProtocolMoesiCmpDirectory
        bool "MOESI CMP directory"
    config RubyProtocolMoesiCmpToken
        bool "MOESI CMP token"
    config RubyProtocolMoesiHammer
        bool "MOESI hammer"
    config RubyProtocolGarnetStandalone
        bool "Garnet standalone"
endchoice

rsource "chi/Kconfig"
```
